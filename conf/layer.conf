## conf/layer.conf
```bitbake
# We have a conf and classes directory, append to BBPATH
BBPATH .= ":${LAYERDIR}"

# We have recipes-* directories, add to BBFILES
BBFILES += "${LAYERDIR}/recipes-*/*/*.bb ${LAYERDIR}/recipes-*/*/*.bbappend"

BBFILE_COLLECTIONS += "toradex-extras-layer"
BBFILE_PATTERN_toradex-extras-layer := "^${LAYERDIR}/"
BBFILE_PRIORITY_toradex-extras-layer = "90"

# Let us add layer-specific bbappends which are only applied when that
# layer is included in our configuration
BBFILES += "${@' '.join('${LAYERDIR}/%s/recipes*/*/*.bbappend' % layer \
               for layer in BBFILE_COLLECTIONS.split())}"
# Add layer-specific bb files too
BBFILES += "${@' '.join('${LAYERDIR}/%s/recipes*/*/*.bb' % layer \
               for layer in BBFILE_COLLECTIONS.split())}"

LAYERDEPENDS_toradex-extras-layer = " \
    core \
    openembedded-layer \
    multimedia-layer \
    networking-layer \
    angstrom-layer \
    browser-layer \
    lxde-layer \
    qt5-layer \
    toradex-tegra-layer \ 
    toradex-demos \
"
```
